## libs/libtirpc/Config.in
```kconfig
menu "Select libtirpc configuration options"
        depends on PACKAGE_libtirpc

config PACKAGE_LIBTIRPC_KRB5
	bool "Include support for krb5"
	default n

endmenu
```

## net/nfs-kernel-server/Config.in
```kconfig
menu "Select nfs-kernel-server configuration options"

config NFS_KERNEL_SERVER_V4
	bool "Include support for NFSv4"
	default y

config NFS_KERNEL_SERVER_KRB5
	bool "Include support for krb5"
	select PACKAGE_LIBTIRPC_KRB5
	default n

endmenu
```
